## config/west.yml
```yaml
manifest:
  remotes:
    - name: zmkfirmware
      url-base: https://github.com/zmkfirmware
    - name: delusionallogic
      url-base: https://github.com/DelusionalLogic
  projects:
    - name: zmk
      remote: delusionallogic
      revision: mouse0buttons
      import: app/west.yml
  self:
    path: config
```
