/*
 * Copyright (c) 2020 The ZMK Contributors
 *
 * SPDX-License-Identifier: MIT
 */

#include <behaviors.dtsi>
#include <dt-bindings/zmk/keys.h>


&mt {
  flavor = "tap-preferred";
  tapping_term_ms = <200>;
};

/ {

    behaviors {
      hm: homerow_mods {
        compatible = "zmk,behavior-hold-tap";
        label = "HOMEROW_MODS";
        #binding-cells = <2>
        tapping-term-ms = <200>;
        quick_tap_ms = <0>;
        flavor = "tap-preferred";
        bindings = <&kp>, <&kp>;
      };
      td: tapdance {
        compatible = "zmk,behavior-hold-tap";
        label = "TAPDANCE";
        #binding-cells = <2>;
        tapping-term-ms = <150>;
        quick_tap_ms = <0>;
        flavor = "tap-preferred";
        bindings = <&kp>, <&kp>;
      };
    };

  };

  keymap {
    compatible = "zmk,keymap";

    layer_0 {
      bindings = <
        &kp Q &kp W       &kp E       &kp R       &kp T                                       &kp Y     &kp U       &kp I           &kp O         &kp P
        &kp A &hm LGUI S  &hm LALT D  &hm LCTRL F &kp G                                       &kp H     &hm RCTRL J &jm RALT K      &hm RGUI L    &kp SEMI
        &kp Z &kp X       &kp C       &kp V       &kp B                                       &kp N     &kp M       &td MINUS COMMA &td EXCL DOT  &td UNDERSCORE SLASH
                                                  &sk LSHIFT &mt LC(LS(LALT))) SPC    &sk ENT &to 1
        >;
    };

    layer_1 {
      bindings = <
        &kp NUM_1   &kp NUM_2 &kp NUM_3 &kp NUM_4       &kp NUM_5                       &kp NUM_6 &kp NUM_7 &kp NUM_8 &kp NUM_9 &kp NUM_0
        &kp BKSP    &kp TAB   &kp PIPE  &kp trans       &kp trans                       &kp LEFT  &kp DOWN  &kp UP    &kp RIGHT &kp DEL
        &kp ESC     &kp TILDE &kp BSLSH &kp NON_US_HASH &kp trans                       &kp trans &kp trans &kp trans &kp trans &trans
                                                        &to 0 &kp LSHIFT      &kp RALT  &to 2
        >;
    };

    layer_2 {
      bindings = <
        &kp trans &kp trans &kp trans &kp trans &kp LPRN                              &kp RPRN      &kp trans &kp trans &kp trans &kp trans
        &kp trans &kp trans &kp trans &kp trans &kp LS(LBKT)                          &kp LS(RBKT)  &kp trans &kp trans &kp trans &kp trans
        &kp trans &kp trans &kp trans &kp trans &kp LBKT                              &kp RBKT      &kp trans &kp trans &kp trans &kp trans
                                                &to 0 &kp LCTL                &kp SPC &to 1
        >;
    };
  };
};